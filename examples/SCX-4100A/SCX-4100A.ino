// READ DUMP AT24C08 (C)UA6EM 21.02.2022

#include <Wire.h>
#include <Eeprom24C04_16.h>
#define EEPROM_ADDRESS 0x50

static Eeprom24C04_16 eeprom(EEPROM_ADDRESS);

  // Declare byte arrays.
  byte outputBytes[512] = {
    0x43, 0x34, 0x32, 0x30, 0x30, 0x45, 0x58, 0x50, 0x00, 0x00, 0x00, 0x00, 0x00, 0x00, 0x00, 0x00,
    0x00, 0x00, 0x00, 0x00, 0x00, 0x00, 0x00, 0x00, 0x00, 0x00, 0x00, 0x00, 0x00, 0x00, 0x00, 0x00,
    0x03, 0x00, 0x00, 0x00, 0x00, 0x00, 0x00, 0x00, 0x32, 0x30, 0x31, 0x33, 0x30, 0x37, 0x00, 0x00,
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    0xFF, 0xFF, 0xFF, 0xFF, 0xFF, 0xFF, 0xFF, 0xFF, 0xFF, 0xFF, 0xFF, 0xFF, 0xFF, 0xFF, 0xFF, 0xFF
  };

  byte inputBytes[512] = {0};


void setup()
{
  // Initialize serial communication.
  Serial.begin(115200);

  // Initiliaze EEPROM library.
  eeprom.initialize();

  Serial.println("WRITE bytes to EEPROM memory...");
  eeprom.writeBytes(0, 512, outputBytes);

  // Чистим буфер
  for (int i = 0; i < 512; i++) {
    inputBytes[i] = 0;
  }


  // Read array with bytes read from EEPROM memory.
  Serial.println("Read bytes from EEPROM memory...");
  eeprom.readBytes(0, 512, inputBytes);

  // Print read bytes.
  for (int i = 0; i < 512; i++)
  {
    if (i % 8 == 0)   Serial.print("  ");
    if (i % 16 == 0)  {
      Serial.println();
      if (i / 4096 == 0)Serial.print("0");
      if (i / 256 == 0) Serial.print("0");
      if (i / 16 == 0)  Serial.print("0");
      Serial.print(i, HEX);
      Serial.print("   ");
    }
    if (inputBytes[i] < 10)Serial.print("0");
    Serial.print(inputBytes[i], HEX);
    Serial.print(" ");
  }
}


void loop()
{
}
